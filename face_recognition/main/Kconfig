## face_recognition/main/Kconfig
```kconfig
menu "WiFi Configuration"
    config WIFI_SSID
        string "WiFi SSID"
        default "your_default_ssid"
        help
            SSID of the network you want to connect to.

    config WIFI_PASSWORD
        string "WiFi Password"
        default "your_default_password"
        help
            Password of the network.
    config MQTT_BROKER_URI
        string "Mqtt Broker Uri"
        default "mqtt://broker.hivemq.com:1883"
        help
            URI of the MQTT broker (mqtt://host:port)

endmenu
```
